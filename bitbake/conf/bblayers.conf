## bitbake/conf/bblayers.conf
```bitbake
BBPATH := "${TOPDIR}"
BBFILES ?= ""
BBLAYERS = "${TOPDIR}/../meta-keystation"
BBLAYERS ?= " \
  ${TOPDIR}/../meta-keystation \
  ${TOPDIR}/../meta-raspberrypi \
  ${TOPDIR}/../openembedded-core/meta \
  "
; TODO: Generate BBLAYERS automatically?
```

## bitbake/conf/local.conf
```bitbake
MACHINE ??= "raspberrypi4-64"

#DL_DIR ?= "${TOPDIR}/downloads"
#SSTATE_DIR ?= "${TOPDIR}/sstate-cache"
#TMPDIR = "${TOPDIR}/tmp"


DISTRO ?= "keystation"

#
# SDK target architecture
#
# This variable specifies the architecture to build SDK items for and means
# you can build the SDK packages for architectures other than the machine you are
# running the build on (i.e. building i686 packages on an x86_64 host).
# Supported values are i686, x86_64, aarch64
#SDKMACHINE ?= "i686"

#
# Extra image configuration defaults
#
# The EXTRA_IMAGE_FEATURES variable allows extra packages to be added to the generated
# images. Some of these options are added to certain image types automatically. The
# variable can contain the following options:
#  "dbg-pkgs"       - add -dbg packages for all installed packages
#                     (adds symbol information for debugging/profiling)
#  "src-pkgs"       - add -src packages for all installed packages
#                     (adds source code for debugging)
#  "dev-pkgs"       - add -dev packages for all installed packages
#                     (useful if you want to develop against libs in the image)
#  "ptest-pkgs"     - add -ptest packages for all ptest-enabled packages
#                     (useful if you want to run the package test suites)
#  "tools-sdk"      - add development tools (gcc, make, pkgconfig etc.)
#  "tools-debug"    - add debugging tools (gdb, strace)
#  "eclipse-debug"  - add Eclipse remote debugging support
#  "tools-profile"  - add profiling tools (oprofile, lttng, valgrind)
#  "tools-testapps" - add useful testing tools (ts_print, aplay, arecord etc.)
#  "debug-tweaks"   - make an image suitable for development
#                     e.g. ssh root access has a blank password
# There are other application targets that can be used here too, see
# meta/classes-recipe/image.bbclass and
# meta/classes-recipe/core-image.bbclass for more details.
# We default to enabling the debugging tweaks.
EXTRA_IMAGE_FEATURES ?= "debug-tweaks"


USER_CLASSES ?= "buildstats"

# By default disable interactive patch resolution (tasks will just fail instead):
PATCHRESOLVE = "noop"

#
# Disk Space Monitoring during the build
#
# Monitor the disk space during the build. If there is less that 1GB of space or less
# than 100K inodes in any key build location (TMPDIR, DL_DIR, SSTATE_DIR), gracefully
# shutdown the build. If there is less than 100MB or 1K inodes, perform a hard halt
# of the build. The reason for this is that running completely out of space can corrupt
# files and damages the build in ways which may not be easily recoverable.
# It's necessary to monitor /tmp, if there is no space left the build will fail
# with very exotic errors.
BB_DISKMON_DIRS ??= "\
    STOPTASKS,${TMPDIR},1G,100K \
    STOPTASKS,${DL_DIR},1G,100K \
    STOPTASKS,${SSTATE_DIR},1G,100K \
    STOPTASKS,/tmp,100M,100K \
    HALT,${TMPDIR},100M,1K \
    HALT,${DL_DIR},100M,1K \
    HALT,${SSTATE_DIR},100M,1K \
    HALT,/tmp,10M,1K"

#
# Qemu configuration
#
# By default native qemu will build with a builtin VNC server where graphical output can be
# seen. The line below enables the SDL UI frontend too.
PACKAGECONFIG:append:pn-qemu-system-native = " sdl"

# CONF_VERSION is increased each time build/conf/ changes incompatibly and is used to
# track the version of this file when it was generated. This can safely be ignored if
# this doesn't mean anything to you.
CONF_VERSION = "2"
```

## bitbake/meta-keystation/conf/distro/keystation.conf
```bitbake
DISTRO_NAME = "Keystation"
DISTRO_VERSION = "1.0"

DISTRO_FEATURES = "sysvinit usbgadget usbhost"
```

## buildroot/Config.in
```kconfig
source "$BR2_EXTERNAL_KBS_PATH/package/loadmodules/Config.in"
source "$BR2_EXTERNAL_KBS_PATH/package/cardinal/Config.in"
source "$BR2_EXTERNAL_KBS_PATH/package/jackd/Config.in"
source "$BR2_EXTERNAL_KBS_PATH/package/jack-tools/Config.in"
source "$BR2_EXTERNAL_KBS_PATH/package/patch-loader/Config.in"
source "$BR2_EXTERNAL_KBS_PATH/package/usb-gadget/Config.in"
source "$BR2_EXTERNAL_KBS_PATH/package/key-firmware/Config.in"
source "$BR2_EXTERNAL_KBS_PATH/package/update-daemon/Config.in"
source "$BR2_EXTERNAL_KBS_PATH/package/keyboard-daemon/Config.in"
source "$BR2_EXTERNAL_KBS_PATH/package/keystation/Config.in"
```

## buildroot/configs/keystation_defconfig
```kconfig
BR2_aarch64=y
BR2_cortex_a72=y
BR2_ARM_FPU_VFPV4=y
BR2_TOOLCHAIN_BUILDROOT_CXX=y
BR2_CCACHE=y
BR2_SYSTEM_DHCP="eth0"
BR2_ROOTFS_POST_BUILD_SCRIPT="$(BR2_EXTERNAL_KBS_PATH)/board/raspberrypi4-64/post-build.sh"
BR2_ROOTFS_POST_IMAGE_SCRIPT="$(BR2_EXTERNAL_KBS_PATH)/board/raspberrypi4-64/post-image.sh"
BR2_LINUX_KERNEL=y
BR2_LINUX_KERNEL_CUSTOM_TARBALL=y
BR2_LINUX_KERNEL_CUSTOM_TARBALL_LOCATION="$(call github,raspberrypi,linux,a2fb37fbc6cc3f92c3ea2e1d8f4e15d924ac860c)/linux-a2fb37fbc6cc3f92c3ea2e1d8f4e15d924ac860c.tar.gz"
BR2_LINUX_KERNEL_DEFCONFIG="bcm2711"
BR2_LINUX_KERNEL_DTS_SUPPORT=y
BR2_LINUX_KERNEL_INTREE_DTS_NAME="broadcom/bcm2711-rpi-4-b"
BR2_LINUX_KERNEL_NEEDS_HOST_OPENSSL=y
BR2_PACKAGE_BUSYBOX_SHOW_OTHERS=y
BR2_PACKAGE_ALSA_UTILS=y
BR2_PACKAGE_ALSA_UTILS_ALSACONF=y
BR2_PACKAGE_ALSA_UTILS_AMIDI=y
BR2_PACKAGE_ALSA_UTILS_AMIXER=y
BR2_PACKAGE_ALSA_UTILS_APLAY=y
BR2_PACKAGE_ALSA_UTILS_APLAYMIDI=y
BR2_PACKAGE_ALSA_UTILS_ASEQDUMP=y
BR2_PACKAGE_ALSA_UTILS_SPEAKER_TEST=y
BR2_PACKAGE_JACK2=y
BR2_PACKAGE_XZ=y
BR2_PACKAGE_LIBTOOL=y
BR2_PACKAGE_RPI_FIRMWARE=y
BR2_PACKAGE_RPI_FIRMWARE_VARIANT_PI4=y
BR2_PACKAGE_RPI_FIRMWARE_CONFIG_FILE="$(BR2_EXTERNAL_KBS_PATH)/board/raspberrypi4-64/config_4_64bit.txt"
BR2_PACKAGE_RPI_FIRMWARE_CMDLINE_FILE="$(BR2_EXTERNAL_KBS_PATH)/board/raspberrypi4-64/cmdline.txt"
BR2_PACKAGE_RASPI_GPIO=y
BR2_PACKAGE_RPI_USERLAND=y
BR2_PACKAGE_ALSA_PLUGINS=y
BR2_PACKAGE_LIBSNDFILE=y
BR2_PACKAGE_LIBDRM=y
BR2_PACKAGE_LIBDRM_VC4=y
BR2_PACKAGE_EXPAT=y
BR2_PACKAGE_LIBGLIB2=y
BR2_PACKAGE_XUTIL_UTIL_MACROS=y
BR2_PACKAGE_KMOD=y
BR2_PACKAGE_KMOD_TOOLS=y
BR2_TARGET_ROOTFS_EXT2=y
BR2_TARGET_ROOTFS_EXT2_4=y
BR2_TARGET_ROOTFS_EXT2_SIZE="2G"
# BR2_TARGET_ROOTFS_TAR is not set
BR2_PACKAGE_HOST_DOSFSTOOLS=y
BR2_PACKAGE_HOST_GENIMAGE=y
BR2_PACKAGE_HOST_KMOD_XZ=y
BR2_PACKAGE_HOST_MTOOLS=y
BR2_PACKAGE_MIDI_TOOLS=y
BR2_PACKAGE_KEYSTATION=y
```

## buildroot/package/builtin-patches/Config.in
```kconfig
config BR2_PACKAGE_BUILTIN_PATCHES
	bool "builtin-patches"
	help
	    Builtin patches for Cardinal
```

## buildroot/package/cardinal/Config.in
```kconfig
config BR2_PACKAGE_CARDINAL
	bool "cardinal"
	depends on BR2_PACKAGE_JACK2
	depends on BR2_PACKAGE_ALSA_LIB
	select BR2_PACKAGE_PATCH_LOADER
	select BR2_PACKAGE_LIBLO
	select BR2_PACKAGE_FFTW
	select BR2_PACKAGE_FFTW_FAST
	select BR2_PACKAGE_FFTW_SINGLE
	select BR2_PACKAGE_LIBSNDFILE
	select BR2_PACKAGE_LIBARCHIVE
	select BR2_PACKAGE_LIBSAMPLERATE
	select BR2_PACKAGE_JANSSON
	select BR2_PACKAGE_SPEEXDSP
	select BR2_PACKAGE_JACK_TOOLS
	help
	    Virtual modular synthesizer plugin
```

## buildroot/package/jack-tools/Config.in
```kconfig
config BR2_PACKAGE_JACK_TOOLS
	bool "jack-tools"
	depends on BR2_PACKAGE_JACK2
	depends on BR2_PACKAGE_ALSA_LIB
	select BR2_PACKAGE_HOST_PKG_CONF
	select BR2_PACKAGE_LIBSNDFILE
    select BR2_PACKAGE_LIBSAMPLERATE
	help
	    Official examples and tools from the JACK project
```

## buildroot/package/jackd/Config.in
```kconfig
config BR2_PACKAGE_JACKD
	bool "jackd"
	depends on BR2_PACKAGE_JACK2
	help
	    Init scripts for jackd
```

## buildroot/package/key-controller/Config.in
```kconfig
config BR2_PACKAGE_KEY_CONTROLLER
	bool "key-controller"
    depends on BR2_PACKAGE_HOST_RUSTC_TARGET_ARCH_SUPPORTS
    select BR2_PACKAGE_HOST_RUSTC
	help
	    Runs keyboard menu on the OLED screen

comment "key-controller needs rustc with target arch support"
    depends on !BR2_PACKAGE_HOST_RUSTC_TARGET_ARCH_SUPPORTS
```

## buildroot/package/key-driver/Config.in
```kconfig
config BR2_PACKAGE_KEY_DRIVER
	bool "key-driver"
    depends on BR2_PACKAGE_HOST_RUSTC_TARGET_ARCH_SUPPORTS
	depends on BR2_PACKAGE_JACK2
    select BR2_PACKAGE_HOST_RUSTC
    select BR2_PACKAGE_KEY_FIRMWARE
    select BR2_PACKAGE_JACK_TOOLS
    select BR2_PACKAGE_RS_TTY
	help
	    Userspace driver for the keyboard

comment "key-driver needs rustc with target arch support"
    depends on !BR2_PACKAGE_HOST_RUSTC_TARGET_ARCH_SUPPORTS

comment "key-driver needs jack"
    depends on !BR2_PACKAGE_JACK2
```

## buildroot/package/key-firmware/Config.in
```kconfig
config BR2_PACKAGE_KEY_FIRMWARE
	bool "key-firmware"
	help
	    Firmware binaries for key-driver
```

## buildroot/package/keyboard-daemon/Config.in
```kconfig
config BR2_PACKAGE_KEYBOARD_DAEMON
	bool "keyboard-daemon"
    depends on BR2_PACKAGE_HOST_RUSTC_TARGET_ARCH_SUPPORTS
	depends on BR2_PACKAGE_JACK2
    select BR2_PACKAGE_HOST_RUSTC
    select BR2_PACKAGE_KEY_FIRMWARE
    select BR2_PACKAGE_JACK_TOOLS
	help
	    Daemon for all keyboard functions 

comment "keyboard-daemon needs rustc with target arch support"
    depends on !BR2_PACKAGE_HOST_RUSTC_TARGET_ARCH_SUPPORTS

comment "keyboard-daemon needs jack"
    depends on !BR2_PACKAGE_JACK2
```

## buildroot/package/keystation/Config.in
```kconfig
config BR2_PACKAGE_KEYSTATION
	bool "keystation"
	select BR2_PACKAGE_LOADMODULES
	select BR2_PACKAGE_JACKD
	select BR2_PACKAGE_CARDINAL
	select BR2_PACKAGE_PATCH_LOADER
	select BR2_PACKAGE_USB_GADGET
	select BR2_PACKAGE_UPDATE_DAEMON
	select BR2_PACKAGE_KEYBOARD_DAEMON
	help
	   OS root package
```

## buildroot/package/loadmodules/Config.in
```kconfig
config BR2_PACKAGE_LOADMODULES
	bool "loadmodules"
	help
	    Load etc/modules at boot
```

## buildroot/package/midi-gadget/Config.in
```kconfig
config BR2_PACKAGE_MIDI_GADGET
	bool "midi-gadget"
	select loadmodules
	help
	    Setup linux to act as usb midi client
```

## buildroot/package/midi-tools/Config.in
```kconfig
config BR2_PACKAGE_MIDI_TOOLS
	bool "midi-tools"
    depends on BR2_PACKAGE_HOST_RUSTC_TARGET_ARCH_SUPPORTS
    select BR2_PACKAGE_HOST_RUSTC
	help
	    CLI tools for introspecting midi devices

comment "midi-tools needs rustc with target arch support"
    depends on !BR2_PACKAGE_HOST_RUSTC_TARGET_ARCH_SUPPORTS
```

## buildroot/package/patch-loader/Config.in
```kconfig
config BR2_PACKAGE_PATCH_LOADER
	bool "patch-loader"
    depends on BR2_PACKAGE_HOST_RUSTC_TARGET_ARCH_SUPPORTS
    select BR2_PACKAGE_HOST_RUSTC
	help
	    Tool for loading synth patch files

comment "patch-loader needs rustc with target arch support"
    depends on !BR2_PACKAGE_HOST_RUSTC_TARGET_ARCH_SUPPORTS
```

## buildroot/package/rs-tty/Config.in
```kconfig
config BR2_PACKAGE_RS_TTY
	bool "rs-tty"
    depends on BR2_PACKAGE_HOST_RUSTC_TARGET_ARCH_SUPPORTS
    select BR2_PACKAGE_HOST_RUSTC
	help
	    Rust crate for interacting with TTYs

comment "rs-tty needs rustc with target arch support"
    depends on !BR2_PACKAGE_HOST_RUSTC_TARGET_ARCH_SUPPORTS
```

## buildroot/package/serial-gadget/Config.in
```kconfig
config BR2_PACKAGE_SERIAL_GADGET
	bool "serial-gadget"
	select loadmodules
	help
	    Provide a serial console over USB
```

## buildroot/package/update-daemon/Config.in
```kconfig
config BR2_PACKAGE_UPDATE_DAEMON
	bool "update-daemon"
	select BR2_PACKAGE_USB_GADGET
	help
	    System daemon for coordinating updates over USB
```

## buildroot/package/usb-gadget/Config.in
```kconfig
config BR2_PACKAGE_USB_GADGET
	bool "usb-gadget"
	select BR2_PACKAGE_LOADMODULES
	help
	    Configure a usb gadget for midi + serial
```

## buildroot/package/vcvrack2/Config.in
```kconfig
config BR2_PACKAGE_VCVRACK2
	bool "vcvrack2"
	select BR2_PACKAGE_LIBGLFW
	depends on BR2_PACKAGE_HAS_LIBGL
	help
	    The virtual Eurorack studio

comment "vcvrack needs libgl"
    depends on !BR2_PACKAGE_HAS_LIBGL
```
