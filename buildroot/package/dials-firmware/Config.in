## buildroot/package/dials-firmware/Config.in
```kconfig
config BR2_PACKAGE_DIALS_FIRMWARE
	bool "dials-firmware"
	help
	    Firmware binaries for arduino under the dials
```

## buildroot/package/keyboard-firmware/Config.in
```kconfig
config BR2_PACKAGE_KEYBOARD_FIRMWARE
	bool "keyboard-firmware"
	help
	    Firmware binaries for arduino under the keys
```

## buildroot/package/mdev-conf/Config.in
```kconfig
config BR2_PACKAGE_MDEV_CONF
	bool "mdev-conf"
	help
	    Configures mdev to assign persistent dev names to the two arduinos
```
